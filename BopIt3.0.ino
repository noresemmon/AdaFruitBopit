#include <Adafruit_CircuitPlayground.h>
#include <Wire.h>
#include <SPI.h>
#include <time.h>  

const byte interruptSwitch = 7; 
const byte interruptLeftButton = 4;
const byte interruptRightButton = 5;


const uint8_t spIT[]            PROGMEM ={0x2B,0x19,0xC1,0x99,0x3D,0xDE,0xEC,0xE2,0x14,0x2D,0xBA,0x88,0xE5,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0x00,0x00};
const uint8_t spPRESS[]         PROGMEM = {0x02,0x28,0x31,0x43,0x03,0x25,0xCB,0xBE,0xDC,0x5D,0xED,0x94,0x22,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0xFF,0x07};
const uint8_t spSWITCH[]        PROGMEM = {0x08,0xF8,0x3B,0x93,0x03,0x1A,0xB0,0x80,0x01,0xAE,0xCF,0x54,0x40,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0xFF,0x07};
const uint8_t spMOVE[]          PROGMEM = {0x6A,0xD7,0xC2,0xF2,0xD2,0xEC,0xB8,0x39,0x08,0xF6,0x4D,0x4D,0x1A,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0xFF,0x07};
const uint8_t spOVER[]          PROGMEM = {0x63,0x6F,0xC4,0x7A,0x1D,0xB5,0xED,0x61,0x37,0xBB,0x6E,0x75,0x62,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0xFD,0xFF};
const uint8_t spGAMES[]         PROGMEM = {0xAA,0x15,0x24,0x2A,0xD6,0xE4,0xB6,0xB6,0x79,0x13,0xB1,0x5C,0xB2,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0x00,0x00};
const uint8_t spPOINT[]         PROGMEM = {0x0A,0xC8,0x2E,0x8C,0x01,0xD1,0x85,0x95,0x34,0x8B,0xAA,0x74,0x56,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0xFB,0x7F};
const uint8_t spONE[]           PROGMEM = {0x66,0x4E,0xA8,0x7A,0x8D,0xED,0xC4,0xB5,0xCD,0x89,0xD4,0xBC,0xA2,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0xFE,0x1F};
const uint8_t spSAY[]           PROGMEM = {0x08,0x78,0xDE,0x5C,0x03,0x16,0xB0,0x80,0x05,0x2C,0x60,0x01,0x0D,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0x07,0x7A};
const uint8_t spLEVEL[]         PROGMEM = {0xA5,0x1E,0x40,0x27,0x84,0xF3,0x94,0xB6,0x03,0x5F,0x65,0x8F,0x9B,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0xFF,0x03};
const uint8_t spTWO[]           PROGMEM = {0x06,0xB8,0x59,0x34,0x00,0x27,0xD6,0x38,0x60,0x58,0xD3,0x91,0x55,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0xFF,0x1F};
const uint8_t spTHREE[]         PROGMEM = {0x0C,0xE8,0x2E,0x94,0x01,0x4D,0xBA,0x4A,0x40,0x03,0x16,0x68,0x69,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0xFF,0x03};
const uint8_t spFOUR[]          PROGMEM = {0xC0,0x00,0x23,0x2D,0x24,0xA0,0x01,0x0B,0x58,0x20,0xC5,0xBC,0xF7,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0x00,0x00};
const uint8_t spFIVE[]          PROGMEM = {0x08,0x68,0x4E,0x9D,0x02,0x1C,0x60,0xC0,0x8C,0x69,0x12,0xB0,0xC0,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0xFF,0x01};
const uint8_t spSIX[]           PROGMEM = {0x04,0xF8,0xB9,0x55,0x01,0xBF,0xA5,0x1B,0xE0,0x37,0x0F,0x03,0xFC,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0xFC,0x3F};
const uint8_t spLESS[]          PROGMEM = {0xA6,0x16,0xBA,0xDB,0x43,0x52,0x85,0xD6,0x88,0x2A,0x76,0x6D,0x53,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0x00,0x00};
const uint8_t spEND[]           PROGMEM = {0xA3,0xC8,0x4D,0x4D,0x3C,0x63,0x9F,0xA2,0xB4,0x34,0x51,0x5F,0x7B,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0xD6,0x03};

volatile bool resetFlag = false;

volatile bool gameOver = false;
volatile bool state = false; 
volatile bool switchFlag = false;
volatile bool leftFlag = false;
volatile bool rightFlag = false;
volatile bool gameStart = false;


float X, Y, Z, totalAccel;
int highscore;
int d; 
volatile int points = 0;
int modeControl = 0;
float s = 0;
int levelFlag = 1;
String command; //no clue why but code runs better with this ¯\_(ツ)_/¯



void setup() {
  CircuitPlayground.begin();

  srand(analogRead(A0));
  CircuitPlayground.setAccelRange(LIS3DH_RANGE_8_G);
  attachInterrupt(digitalPinToInterrupt(interruptSwitch), Switch, CHANGE);
   attachInterrupt(digitalPinToInterrupt(interruptLeftButton), leftButton, RISING);
  attachInterrupt(digitalPinToInterrupt(interruptRightButton), rightButton, RISING);
  CircuitPlayground.speaker.set(255);
Serial.begin(9600);
while(!Serial);
}

void loop() {
  delay(100);
  if (gameStart == false){
    Serial.println("Press both buttons to start");
    for (int i = 0; i < 10; i++){
        CircuitPlayground.setPixelColor(i,255,0,0);
        delay(100); }
        for(int i = 11; i >= 0; i--){
          CircuitPlayground.setPixelColor(i,0,255,0);
          delay(100);
  }
}
  if (rightFlag && leftFlag){
    leftFlag = false;
    rightFlag = false;
    gameStart = true;
  }


  if (gameStart == true){
  if (gameOver == false && points < 3){
    resetFlag = false;
    if (levelFlag == 1){
    Serial.println("level 1");
    CircuitPlayground.speaker.say(spLEVEL);  
    delay(100);
    CircuitPlayground.speaker.say(spONE);  
    levelFlag++;
}
  d = 350;
  level(); 
  } 
  if (gameOver == false && points >= 3 && points < 7){
     if (levelFlag == 2){
    Serial.println("level 2");
    CircuitPlayground.speaker.say(spLEVEL);  
    delay(100);
    CircuitPlayground.speaker.say(spTWO);
    levelFlag++;
}
   d = 300;
  level(); 
}
if (gameOver == false && points >= 7 && points < 12){
     if (levelFlag == 3){
       Serial.println("level 3");
    CircuitPlayground.speaker.say(spLEVEL);  
    delay(100);
    CircuitPlayground.speaker.say(spTHREE);  
    levelFlag++;
}
d = 250;
level();
}
if (gameOver == false && points >= 12 && points < 18){
     if (levelFlag == 4){
       Serial.println("level 4");
    CircuitPlayground.speaker.say(spLEVEL);  
    delay(100);
    CircuitPlayground.speaker.say(spFOUR);  
    levelFlag++;
}
d = 200;
level();
}
if (gameOver == false && points >= 18 && points < 25){
     if (levelFlag == 5){
       Serial.println("level 5");
    CircuitPlayground.speaker.say(spLEVEL);  
    delay(100);
    CircuitPlayground.speaker.say(spFIVE);  
    levelFlag++;
}
d = 150;
level();
}
if (gameOver == false && points >= 25 && points < 33){
     if (levelFlag == 6){
       Serial.println("level 6");
    CircuitPlayground.speaker.say(spLEVEL);  
    delay(100);
    CircuitPlayground.speaker.say(spSIX);
    levelFlag++;
}
d = 100;
level();
}
if (gameOver == false && points >= 33){
     if (levelFlag == 7){
    Serial.println("Endless level");
    CircuitPlayground.speaker.say(spEND);  
    delay(50);
    CircuitPlayground.speaker.say(spLESS);  
    delay(100);
    CircuitPlayground.speaker.say(spLEVEL);  
   levelFlag++;
}
d--;
level();
}


 if (gameOver){
      CircuitPlayground.clearPixels();
      for (int i = 0; i < 10; i++){
        CircuitPlayground.setPixelColor(i,255,165,0);
        delay(100); }
        CircuitPlayground.clearPixels();
        delay(10);
        for(int i = 11; i >= 0; i--){
          CircuitPlayground.setPixelColor(i,255,165,0);
          delay(100);
        }
      

      
      if (rightFlag && leftFlag){
      gameOver = false;
      points = 0;
      levelFlag = 1;
      switchFlag = false;
      leftFlag   = false;
      rightFlag  = false;
      }
      if (resetFlag == false){
    Serial.println("GAME OVER");
    delay(1000);
    Serial.print("Total points  ");
    Serial.println(points);
    if (highscore < points){
      Serial.println("NEW HIGHSCORE!!");
      highscore = points;
    }
    Serial.print("Your highscore is ");
    Serial.println(highscore);
    delay(2000);
    Serial.println("Want to play again?");
    Serial.println("Press both buttons!");
    resetFlag = true;
      }
    }
  }
}





void level(){
    if (gameOver == false){
    modeControl = rand() % 4;}
    
  switch(modeControl){
case 0:
delay(100);
  CircuitPlayground.clearPixels();
	CircuitPlayground.speaker.say(spSWITCH);  
    Serial.println("Switch");      
  for (int i = 0; i < 10; i++){
    CircuitPlayground.setPixelColor(i,255,0,0);
      delay(d);
  }
  for (int i = 0; i < 10; i++){
    CircuitPlayground.setPixelColor(i,0,255,0);
  }


if (switchFlag == true){
  switchFlag = false;
  leftFlag = false;
  rightFlag = false;
  points++;
} 

else {
  CircuitPlayground.speaker.say(spGAMES);
  delay(100);
  CircuitPlayground.speaker.say(spOVER);
  gameOver = true;
}
break; 

case 1:
delay(100);
  CircuitPlayground.clearPixels();
	CircuitPlayground.speaker.say(spPRESS);
  Serial.println("Press");
    for (int i = 10; i > 0; i--){
    CircuitPlayground.setPixelColor(i,255,0,0);
      delay(d);
  }
  for (int i = 0; i < 10; i++){
    CircuitPlayground.setPixelColor(i,0,255,0);
  }


if (rightFlag && leftFlag){
  switchFlag = false;
  leftFlag = false;
  rightFlag = false;
  points++;
} else {
    CircuitPlayground.speaker.say(spGAMES);
    delay(100);
  CircuitPlayground.speaker.say(spOVER);
  gameOver = true;
}
break;
default:

case 2:
  delay(100);
  CircuitPlayground.clearPixels();
	CircuitPlayground.speaker.say(spMOVE);
  Serial.println("Move");
    for (int i = 0; i < 10; i++){
    CircuitPlayground.setPixelColor(i,255,0,0);
      delay(d);
  }
  for (int i = 0; i < 10; i++){
    CircuitPlayground.setPixelColor(i,0,255,0);
  }


  X = 0;
  Y = 0;
  Z = 0;
  for (int i=0; i<10; i++) {
    X += CircuitPlayground.motionX();
    Y += CircuitPlayground.motionY();
    Z += CircuitPlayground.motionZ();
    delay(1);
  }
  X /= 10;
  Y /= 10;
  Z /= 10;
  totalAccel = sqrt(X*X + Y*Y + Z*Z);

if (totalAccel > 20){
  switchFlag = false;
  leftFlag = false;
  rightFlag = false;
  points++;
} else {
     CircuitPlayground.speaker.say(spGAMES);
     delay(100);
      CircuitPlayground.speaker.say(spOVER);
        gameOver = true;
  }
 break;

case 3:
  delay(100);
  CircuitPlayground.clearPixels();
  CircuitPlayground.speaker.say(spSAY);
  Serial.println("Say");


    for (int i = 0; i < 10; i++){
    CircuitPlayground.setPixelColor(i,255,0,0);
      delay(d);
  }
  for (int i = 0; i < 10; i++){
    CircuitPlayground.setPixelColor(i,0,255,0);}
    s = CircuitPlayground.mic.soundPressureLevel(100);
    if (s > 70){
    switchFlag = false;
    leftFlag = false;
    rightFlag = false;
    points++;
  } else {
    CircuitPlayground.speaker.say(spGAMES);
     delay(100);
      CircuitPlayground.speaker.say(spOVER);
        gameOver = true;
  }
  break;
  break;
  }
} 
  
  












void Switch(){
  switchFlag = true;
}
void leftButton(){
  leftFlag = true;
}
void rightButton(){
  rightFlag = true;
}
